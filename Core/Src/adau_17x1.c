/**
  ******************************************************************************
  * @file           : adau_17x1.c
  * @brief          : Driver for DSP ADAU 17x1 series
  ******************************************************************************
  * @attention
  *
  * @author         : BeeHa
  * @version		: v1.0.0
  * @date created	: 2024-04-16
  *
  * @author modified:
  * @date modified	:
  *
  * @copyright		: (C) 2024, PT. Hartono Istana Teknologi. All rights reserved.
  *
  ******************************************************************************
  */

/* Includes ------------------------------------------------------------------*/
#include "adau_17x1.h"
#include "sound.h"
#include "system.h"


#ifdef USE_SOUND_SHIFT_EN

/* Private includes ----------------------------------------------------------*/


/* Private typedef -----------------------------------------------------------*/
typedef struct 
{
	uint16_t addr;
	uint16_t size;
	const uint8_t *isi;
}adau17x1_reg;
uint8_t				adau17x1_i2c_buf[4];
HAL_StatusTypeDef	ack = HAL_BUSY;
uint8_t i = 0;


/* Private define ------------------------------------------------------------*/
/** If SigmaStudio is set to use the DSP in SPI mode (default for Sigma300/Sigma350), the
 * SigmaStudio exported device address is 0x00. This causes issues if the microcontroller needs to
 * program the DSP over I2C. If OVERRIDE_SIGMASTUDIO_DEVICE_ADDRESS is true, SigmaStudioFW.cpp will
 * use the following device address instead of the one passed to it by argument. The Wire library
 * uses 7-bit I2C addressing, so the R/W bit is omitted from the device address.
 * NOTE: Manually overwriting DEVICE_ADDR_IC_1 in the SigmaStudio exported file is not a good idea
 * because the file will be re-created scratch every time a new SigmaStudio export is performed. It
 * is better to store this configuration data here. NOTE: Additional software logic will be needed
 * if more than one SigmaDSP IC is connected simultaneously.
 */
#define OVERRIDE_SIGMASTUDIO_DEVICE_ADDRESS
#ifdef OVERRIDE_SIGMASTUDIO_DEVICE_ADDRESS
uint8_t DSP_I2C_ADDR = 0x70;  //0b0111000;    // From ADAU1761 datasheet Table 21, assumes ADDR1 and ADDR0
									   // low (eval board), adjust for your application.
#endif


/* Private macro -------------------------------------------------------------*/


/* Private variables ---------------------------------------------------------*/
const uint8_t ADAU_DSP_SAMPLING_RATE_0 = 0x7F;
const uint8_t ADAU_DSP_RUN_0 = 0x00;
const uint8_t ADAU_CLOCK_CONTROL = 0x07;	//0x0F;
const uint8_t ADAU_PLL_CONTROL[6] = {0x00, 0x01, 0x00, 0x00, 0x20, 0x03};
const uint8_t ADAU_SERIAL_PORT[2] = {0x01, 0x00};
const uint8_t ADAU_ALC[4] = {0x00, 0x00, 0x00, 0x00};
const uint8_t ADAU_DIG_MIG = 0x00;
const uint8_t ADAU_REC_POWER_MGMT[8] = {0x00, 0x51, 0x05, 0x51, 0x05, 0x00, 0x00, 0x00};
const uint8_t ADAU_ADC_CONTROL[3] = {0x13, 0x00, 0x00};
const uint8_t ADAU_PLAY_MIXER[14] = {0x61, 0x00, 0x61, 0x00, 0x03, 0x09, 0x01, 0xE7, 0xE7, 0xE6, 0xE6, 0xE7, 0x00, 0x0F};
const uint8_t ADAU_CONVERTER[2] = {0x00, 0x00};
const uint8_t ADAU_DAC_CONTROL[3] = {0x03, 0x00, 0x00};
const uint8_t ADAU_SERIAL_PORT_PAD = 0xAA;
const uint8_t ADAU_CONTROL_PORT_PAD[2] = {0xAA, 0x00};
const uint8_t ADAU_JACK_DETECT = 0x08;
const uint8_t ADAU_CLEAR_RAM_0[60] = {0x00, 0x00, 0x00, 0x00, 0x00, 0x00, 0x00, 0x00, 0x00, 0x00, 0x00, 0x00, 0x00 ,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 0x00, 0x00};
const uint8_t ADAU_CLEAR_RAM_1[15] = {0x00, 0x00, 0x00, 0x00, 0x00, 0x00, 0x00, 0x00, 0x00, 0x00, 0x00, 0x00, 0x00, 0x00, 0x00};
const uint8_t ADAU_DSP_ENABLE = 0x01;
const uint8_t ADAU_CRC[5] = {0x7F, 0x3D, 0x7F, 0x7F, 0x01};
const uint8_t ADAU_GPIO_PIN_CONTROL[4] = {0x00, 0x00, 0x00, 0x0B};
const uint8_t ADAU_NON_MODULO_RAM[2] = {0x10, 0x00};
const uint8_t ADAU_WATCHDOG_EN[5] = {0x00, 0x04, 0x00, 0x00, 0x00};
const uint8_t ADAU_DSP_SAMPLING_RATE_1 = 0x7F;
const uint8_t ADAU_SERIAL_IN_CONTROL = 0x00;
const uint8_t ADAU_SERIAL_OUT_CONTROL = 0x00;
const uint8_t ADAU_SERIAL_DATA_CONFIG = 0x0F;
const uint8_t ADAU_DSP_SLEW_MODE = 0x00;
const uint8_t ADAU_SERIAL_PORT_SAMPLING_RATE = 0x00;
const uint8_t ADAU_CLOCK_ENABLE[2] = {0x7F, 0x03};
const uint8_t ADAU_PROGRAM_RAM_00[60] = {0x00, 0x00, 0x00, 0x00, 0x00, 0xFE, 0xE0, 0x00, 0x00, 0x00, 0xFF, 0x34, 0x00,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 0x00, 0x00};
const uint8_t ADAU_PROGRAM_RAM_01[60] = {0xFE, 0x30, 0x00, 0xE2, 0x00, 0x00, 0x00, 0x00, 0x00, 0x00, 0x00, 0x00, 0x00,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 0x00, 0x00};
const uint8_t ADAU_PROGRAM_RAM_02[60] = {0xFF, 0x00, 0x00, 0x00, 0x00, 0xFE, 0xC0, 0x22, 0x00, 0x27, 0x00, 0x00, 0x00,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 0xE2, 0x00};
const uint8_t ADAU_PROGRAM_RAM_03[60] = {0xFD, 0xAD, 0x08, 0x20, 0x00, 0x00, 0x08, 0x00, 0xE2, 0x00, 0xFF, 0xE8, 0x08,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 0xE2, 0x00};
const uint8_t ADAU_PROGRAM_RAM_04[60] = {0xFF, 0xF5, 0x08, 0x60, 0x00, 0xFF, 0x80, 0x32, 0x00, 0x00, 0x00, 0x00, 0x00,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 0x40, 0x08};
const uint8_t ADAU_PROGRAM_RAM_05[60] = {0xFF, 0xE8, 0x2F, 0x20, 0x00, 0x00, 0x2D, 0x08, 0x20, 0xA3, 0x00, 0x68, 0x00,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 0x00, 0x00};
const uint8_t ADAU_PROGRAM_RAM_06[60] = {0x00, 0x00, 0x0A, 0xA1, 0x00, 0xFF, 0xE5, 0x08, 0x20, 0x00, 0x00, 0x00, 0x09,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 0xE2, 0x80};
const uint8_t ADAU_PROGRAM_RAM_07[60] = {0x00, 0x00, 0x00, 0x00, 0x00, 0x00, 0x35, 0x08, 0x20, 0x00, 0x00, 0x38, 0x00,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 0x02, 0x00};
const uint8_t ADAU_PROGRAM_RAM_08[60] = {0x00, 0x00, 0x5E, 0xA0, 0x00, 0x00, 0x00, 0x00, 0x00, 0x00, 0x00, 0x00, 0x00,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 0x20, 0x00};
const uint8_t ADAU_PROGRAM_RAM_09[60] = {0x00, 0x58, 0x00, 0xE2, 0x00, 0x00, 0x60, 0x00, 0xF2, 0x00, 0x00, 0x58, 0x00,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 0x20, 0x00};
const uint8_t ADAU_PROGRAM_RAM_10[60] = {0xFF, 0xE5, 0x08, 0x22, 0x00, 0x00, 0x00, 0x5E, 0xA0, 0x00, 0x00, 0x00, 0x00,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 0x30, 0x48};
const uint8_t ADAU_PROGRAM_RAM_11[60] = {0xFF, 0xED, 0x04, 0x20, 0x00, 0x00, 0x98, 0x5F, 0x20, 0x27, 0x00, 0xA0, 0x00,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 0x22, 0x00};
const uint8_t ADAU_PROGRAM_RAM_12[60] = {0x00, 0xBD, 0x08, 0x22, 0x00, 0x00, 0xD0, 0x00, 0xE2, 0x00, 0x00, 0xD8, 0x63,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 0x22, 0x00};
const uint8_t ADAU_PROGRAM_RAM_13[60] = {0x00, 0xED, 0x08, 0x22, 0x00, 0x01, 0x00, 0x00, 0xE2, 0x00, 0x01, 0x08, 0x66,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 0x22, 0x00};
const uint8_t ADAU_PROGRAM_RAM_14[60] = {0x01, 0x1D, 0x08, 0x22, 0x00, 0x01, 0x38, 0x00, 0xE2, 0x00, 0x01, 0x58, 0x6A,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 0x22, 0x00};
const uint8_t ADAU_PROGRAM_RAM_15[60] = {0x01, 0x5D, 0x08, 0x22, 0x00, 0x01, 0x80, 0x00, 0xE2, 0x00, 0x01, 0x88, 0x6E,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 0x22, 0x00};
const uint8_t ADAU_PROGRAM_RAM_16[60] = {0x01, 0xB8, 0x00, 0xE2, 0x00, 0x01, 0xC0, 0x70, 0x20, 0x40, 0x01, 0xB8, 0x70,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 0x22, 0x00};
const uint8_t ADAU_PROGRAM_RAM_17[60] = {0x01, 0xE8, 0x00, 0xE2, 0x00, 0x01, 0xF0, 0x73, 0x20, 0x40, 0x01, 0xE8, 0x73,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 0x22, 0x00};
const uint8_t ADAU_PROGRAM_RAM_18[60] = {0x02, 0x20, 0x00, 0xE2, 0x00, 0x02, 0x40, 0x77, 0x20, 0x40, 0x02, 0x48, 0x76,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 0x22, 0x00};
const uint8_t ADAU_PROGRAM_RAM_19[60] = {0x02, 0x68, 0x00, 0xE2, 0x00, 0x02, 0x70, 0x7B, 0x20, 0x40, 0x02, 0x78, 0x7A,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 0x20, 0x00};
const uint8_t ADAU_PROGRAM_RAM_20[60] = {0x02, 0x88, 0x00, 0xE2, 0x00, 0x00, 0x85, 0x08, 0x20, 0x00, 0x02, 0x90, 0x00,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 0x20, 0x00};
const uint8_t ADAU_PROGRAM_RAM_21[40] = {0xFD, 0xB8, 0x00, 0xE2, 0x00, 0x02, 0xA5, 0x08, 0x20, 0x00, 0xFD, 0xB0, 0x00,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 0x00, 0x00};
const uint8_t ADAU_PARAMETER_RAM_0[60] = {0x00, 0x00, 0x10, 0x00, 0x00, 0x00, 0x00, 0x00, 0x00, 0x00, 0x00, 0x00, 0x00,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 0x4D, 0xD3};
const uint8_t ADAU_PARAMETER_RAM_1[60] = {0x00, 0x40, 0x00, 0x00, 0x00, 0x2B, 0xC6, 0xA8, 0x00, 0x16, 0x45, 0xA2, 0x00,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 0xAE, 0x14};
const uint8_t ADAU_PARAMETER_RAM_2[60] = {0xFF, 0x91, 0x26, 0xE9, 0xFF, 0x9D, 0xF3, 0xB6, 0xFF, 0xAD, 0xB2, 0x2D, 0xFF,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 0x14, 0x7B};
const uint8_t ADAU_PARAMETER_RAM_3[60] = {0x00, 0x80, 0x00, 0x00, 0x00, 0x00, 0x00, 0x00, 0x00, 0x80, 0x00, 0x00, 0x00,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 0x51, 0xEC};
const uint8_t ADAU_PARAMETER_RAM_4[60] = {0x00, 0x7E, 0x14, 0x7B, 0x00, 0x80, 0x00, 0x00, 0x00, 0x7E, 0x14, 0x7B, 0x00,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 0xB2, 0x2D};
const uint8_t ADAU_PARAMETER_RAM_5[60] = {0xFF, 0x9D, 0xF3, 0xB6, 0xFF, 0x91, 0x26, 0xE9, 0xFF, 0x87, 0xAE, 0x14, 0xFF,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 0x00, 0x00};
const uint8_t ADAU_PARAMETER_RAM_6[60] = {0x00, 0x80, 0x00, 0x00, 0x00, 0x80, 0x00, 0x00, 0x00, 0x00, 0x00, 0x24, 0x00,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 0x98, 0x9E};
const uint8_t ADAU_PARAMETER_RAM_7[60] = {0xFF, 0xAF, 0x67, 0x44, 0x00, 0x14, 0xB4, 0xB0, 0xFF, 0xE4, 0xB4, 0xB0, 0x00,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 0xE7, 0x05};
const uint8_t ADAU_PARAMETER_RAM_8[16] = {0x00, 0x09, 0x17, 0x8E, 0x00, 0x0B, 0x86, 0x14, 0x00, 0x40, 0x73, 0x2A, 0x00, 0x1E, 0xE4, 0x88};
const uint8_t ADAU_DSP_SAMPLING_RATE_2 = 0x01;
const uint8_t ADAU_DSP_RUN_1 = 0x01;
const uint8_t ADAU_DEJITTER_CONTROL_0 = 0x00;
const uint8_t ADAU_DEJITTER_CONTROL_1 = 0x03;

const adau17x1_reg adau17x1_reg_defaults[131] = {
	{ADAU_ADDR_DSP_SAMPLING_RATE_0,			    0x01,			&ADAU_DSP_SAMPLING_RATE_0				},
	{ADAU_ADDR_DSP_RUN_0,					    0x01,			&ADAU_DSP_RUN_0							},
	{ADAU_ADDR_CLOCK_CONTROL,				    0x01,			&ADAU_CLOCK_CONTROL						},
	{ADAU_ADDR_PLL_CONTROL,					    0x06,			&ADAU_PLL_CONTROL[0]					},
	{ADAU_ADDR_SERIAL_PORT,					    0x02,			&ADAU_SERIAL_PORT[0]					},
	{ADAU_ADDR_ALC,							    0x04,			&ADAU_ALC[0]							},
	{ADAU_ADDR_DIG_MIG,						    0x01,			&ADAU_DIG_MIG							},
	{ADAU_ADDR_REC_POWER_MGMT,				    0x08,			&ADAU_REC_POWER_MGMT[0]					},
	{ADAU_ADDR_ADC_CONTROL,					    0x03,			&ADAU_ADC_CONTROL[0]					},
	{ADAU_ADDR_PLAY_MIXER,					    0x0E,			&ADAU_PLAY_MIXER[0]						},
	{ADAU_ADDR_CONVERTER,					    0x02,			&ADAU_CONVERTER[0]						},
	{ADAU_ADDR_DAC_CONTROL,					    0x03,			&ADAU_DAC_CONTROL[0]					},
	{ADAU_ADDR_SERIAL_PORT_PAD,				    0x01,			&ADAU_SERIAL_PORT_PAD					},
	{ADAU_ADDR_CONTROL_PORT_PAD,				0x02,			&ADAU_CONTROL_PORT_PAD[0]				},
	{ADAU_ADDR_JACK_DETECT,					    0x01,			&ADAU_JACK_DETECT						},
	{ADAU_ADDR_CLEAR_RAM_00,					0x3C,			&ADAU_CLEAR_RAM_0[0]					},
	{ADAU_ADDR_CLEAR_RAM_01,					0x3C,			&ADAU_CLEAR_RAM_0[0]					},
	{ADAU_ADDR_CLEAR_RAM_02,					0x3C,			&ADAU_CLEAR_RAM_0[0]					},
	{ADAU_ADDR_CLEAR_RAM_03,					0x3C,			&ADAU_CLEAR_RAM_0[0]					},
	{ADAU_ADDR_CLEAR_RAM_04,					0x3C,			&ADAU_CLEAR_RAM_0[0]					},
	{ADAU_ADDR_CLEAR_RAM_05,					0x3C,			&ADAU_CLEAR_RAM_0[0]					},
	{ADAU_ADDR_CLEAR_RAM_06,					0x3C,			&ADAU_CLEAR_RAM_0[0]					},
	{ADAU_ADDR_CLEAR_RAM_07,					0x3C,			&ADAU_CLEAR_RAM_0[0]					},
	{ADAU_ADDR_CLEAR_RAM_08,					0x3C,			&ADAU_CLEAR_RAM_0[0]					},
	{ADAU_ADDR_CLEAR_RAM_09,					0x3C,			&ADAU_CLEAR_RAM_0[0]					},
	{ADAU_ADDR_CLEAR_RAM_10,					0x3C,			&ADAU_CLEAR_RAM_0[0]					},
	{ADAU_ADDR_CLEAR_RAM_11,					0x3C,			&ADAU_CLEAR_RAM_0[0]					},
	{ADAU_ADDR_CLEAR_RAM_12,					0x3C,			&ADAU_CLEAR_RAM_0[0]					},
	{ADAU_ADDR_CLEAR_RAM_13,					0x3C,			&ADAU_CLEAR_RAM_0[0]					},
	{ADAU_ADDR_CLEAR_RAM_14,					0x3C,			&ADAU_CLEAR_RAM_0[0]					},
	{ADAU_ADDR_CLEAR_RAM_15,					0x3C,			&ADAU_CLEAR_RAM_0[0]					},
	{ADAU_ADDR_CLEAR_RAM_16,					0x3C,			&ADAU_CLEAR_RAM_0[0]					},
	{ADAU_ADDR_CLEAR_RAM_17,					0x3C,			&ADAU_CLEAR_RAM_0[0]					},
	{ADAU_ADDR_CLEAR_RAM_18,					0x3C,			&ADAU_CLEAR_RAM_0[0]					},
	{ADAU_ADDR_CLEAR_RAM_19,					0x3C,			&ADAU_CLEAR_RAM_0[0]					},
	{ADAU_ADDR_CLEAR_RAM_20,					0x3C,			&ADAU_CLEAR_RAM_0[0]					},
	{ADAU_ADDR_CLEAR_RAM_21,					0x3C,			&ADAU_CLEAR_RAM_0[0]					},
	{ADAU_ADDR_CLEAR_RAM_22,					0x3C,			&ADAU_CLEAR_RAM_0[0]					},
	{ADAU_ADDR_CLEAR_RAM_23,					0x3C,			&ADAU_CLEAR_RAM_0[0]					},
	{ADAU_ADDR_CLEAR_RAM_24,					0x3C,			&ADAU_CLEAR_RAM_0[0]					},
	{ADAU_ADDR_CLEAR_RAM_25,					0x3C,			&ADAU_CLEAR_RAM_0[0]					},
	{ADAU_ADDR_CLEAR_RAM_26,					0x3C,			&ADAU_CLEAR_RAM_0[0]					},
	{ADAU_ADDR_CLEAR_RAM_27,					0x3C,			&ADAU_CLEAR_RAM_0[0]					},
	{ADAU_ADDR_CLEAR_RAM_28,					0x3C,			&ADAU_CLEAR_RAM_0[0]					},
	{ADAU_ADDR_CLEAR_RAM_29,					0x3C,			&ADAU_CLEAR_RAM_0[0]					},
	{ADAU_ADDR_CLEAR_RAM_30,					0x3C,			&ADAU_CLEAR_RAM_0[0]					},
	{ADAU_ADDR_CLEAR_RAM_31,					0x3C,			&ADAU_CLEAR_RAM_0[0]					},
	{ADAU_ADDR_CLEAR_RAM_32,					0x3C,			&ADAU_CLEAR_RAM_0[0]					},
	{ADAU_ADDR_CLEAR_RAM_33,					0x3C,			&ADAU_CLEAR_RAM_0[0]					},
	{ADAU_ADDR_CLEAR_RAM_34,					0x3C,			&ADAU_CLEAR_RAM_0[0]					},
	{ADAU_ADDR_CLEAR_RAM_35,					0x3C,			&ADAU_CLEAR_RAM_0[0]					},
	{ADAU_ADDR_CLEAR_RAM_36,					0x3C,			&ADAU_CLEAR_RAM_0[0]					},
	{ADAU_ADDR_CLEAR_RAM_37,					0x3C,			&ADAU_CLEAR_RAM_0[0]					},
	{ADAU_ADDR_CLEAR_RAM_38,					0x3C,			&ADAU_CLEAR_RAM_0[0]					},
	{ADAU_ADDR_CLEAR_RAM_39,					0x3C,			&ADAU_CLEAR_RAM_0[0]					},
	{ADAU_ADDR_CLEAR_RAM_40,					0x3C,			&ADAU_CLEAR_RAM_0[0]					},
	{ADAU_ADDR_CLEAR_RAM_41,					0x3C,			&ADAU_CLEAR_RAM_0[0]					},
	{ADAU_ADDR_CLEAR_RAM_42,					0x3C,			&ADAU_CLEAR_RAM_0[0]					},
	{ADAU_ADDR_CLEAR_RAM_43,					0x3C,			&ADAU_CLEAR_RAM_0[0]					},
	{ADAU_ADDR_CLEAR_RAM_44,					0x3C,			&ADAU_CLEAR_RAM_0[0]					},
	{ADAU_ADDR_CLEAR_RAM_45,					0x3C,			&ADAU_CLEAR_RAM_0[0]					},
	{ADAU_ADDR_CLEAR_RAM_46,					0x3C,			&ADAU_CLEAR_RAM_0[0]					},
	{ADAU_ADDR_CLEAR_RAM_47,					0x3C,			&ADAU_CLEAR_RAM_0[0]					},
	{ADAU_ADDR_CLEAR_RAM_48,					0x3C,			&ADAU_CLEAR_RAM_0[0]					},
	{ADAU_ADDR_CLEAR_RAM_49,					0x3C,			&ADAU_CLEAR_RAM_0[0]					},
	{ADAU_ADDR_CLEAR_RAM_50,					0x3C,			&ADAU_CLEAR_RAM_0[0]					},
	{ADAU_ADDR_CLEAR_RAM_51,					0x3C,			&ADAU_CLEAR_RAM_0[0]					},
	{ADAU_ADDR_CLEAR_RAM_52,					0x3C,			&ADAU_CLEAR_RAM_0[0]					},
	{ADAU_ADDR_CLEAR_RAM_53,					0x3C,			&ADAU_CLEAR_RAM_0[0]					},
	{ADAU_ADDR_CLEAR_RAM_54,					0x3C,			&ADAU_CLEAR_RAM_0[0]					},
	{ADAU_ADDR_CLEAR_RAM_55,					0x3C,			&ADAU_CLEAR_RAM_0[0]					},
	{ADAU_ADDR_CLEAR_RAM_56,					0x3C,			&ADAU_CLEAR_RAM_0[0]					},
	{ADAU_ADDR_CLEAR_RAM_57,					0x3C,			&ADAU_CLEAR_RAM_0[0]					},
	{ADAU_ADDR_CLEAR_RAM_58,					0x3C,			&ADAU_CLEAR_RAM_0[0]					},
	{ADAU_ADDR_CLEAR_RAM_59,					0x3C,			&ADAU_CLEAR_RAM_0[0]					},
	{ADAU_ADDR_CLEAR_RAM_60,					0x3C,			&ADAU_CLEAR_RAM_0[0]					},
	{ADAU_ADDR_CLEAR_RAM_61,					0x3C,			&ADAU_CLEAR_RAM_0[0]					},
	{ADAU_ADDR_CLEAR_RAM_62,					0x3C,			&ADAU_CLEAR_RAM_0[0]					},
	{ADAU_ADDR_CLEAR_RAM_63,					0x3C,			&ADAU_CLEAR_RAM_0[0]					},
	{ADAU_ADDR_CLEAR_RAM_64,					0x3C,			&ADAU_CLEAR_RAM_0[0]					},
	{ADAU_ADDR_CLEAR_RAM_65,					0x3C,			&ADAU_CLEAR_RAM_0[0]					},
	{ADAU_ADDR_CLEAR_RAM_66,					0x3C,			&ADAU_CLEAR_RAM_0[0]					},
	{ADAU_ADDR_CLEAR_RAM_67,					0x3C,			&ADAU_CLEAR_RAM_0[0]					},
	{ADAU_ADDR_CLEAR_RAM_68,					0x0F,			&ADAU_CLEAR_RAM_1[0]					},
	{ADAU_ADDR_DSP_ENABLE,					    0x01,			&ADAU_DSP_ENABLE						},
	{ADAU_ADDR_CRC,							    0x05,			&ADAU_CRC[0]							},
	{ADAU_ADDR_GPIO_PIN_CONTROL,				0x04,			&ADAU_GPIO_PIN_CONTROL[0]				},
	{ADAU_ADDR_NON_MODULO_RAM,				    0x02,			&ADAU_NON_MODULO_RAM[0]					},
	{ADAU_ADDR_WATCHDOG_EN,					    0x05,			&ADAU_WATCHDOG_EN[0]					},
	{ADAU_ADDR_DSP_SAMPLING_RATE_1,			    0x01,			&ADAU_DSP_SAMPLING_RATE_1				},
	{ADAU_ADDR_SERIAL_IN_CONTROL,			    0x01,			&ADAU_SERIAL_IN_CONTROL					},
	{ADAU_ADDR_SERIAL_OUT_CONTROL,			    0x01,			&ADAU_SERIAL_OUT_CONTROL				},
	{ADAU_ADDR_SERIAL_DATA_CONFIG,			    0x01,			&ADAU_SERIAL_DATA_CONFIG				},
	{ADAU_ADDR_DSP_SLEW_MODE,				    0x01,			&ADAU_DSP_SLEW_MODE						},
	{ADAU_ADDR_SERIAL_PORT_SAMPLING_RATE,	    0x01,			&ADAU_SERIAL_PORT_SAMPLING_RATE			},
	{ADAU_ADDR_CLOCK_ENABLE,					0x02,			&ADAU_CLOCK_ENABLE[0]					},
	{ADAU_ADDR_PROGRAM_RAM_00,				    0x3C,			&ADAU_PROGRAM_RAM_00[0]					},
	{ADAU_ADDR_PROGRAM_RAM_01,				    0x3C,			&ADAU_PROGRAM_RAM_01[0]					},
	{ADAU_ADDR_PROGRAM_RAM_02,				    0x3C,			&ADAU_PROGRAM_RAM_02[0]					},
	{ADAU_ADDR_PROGRAM_RAM_03,				    0x3C,			&ADAU_PROGRAM_RAM_03[0]					},
	{ADAU_ADDR_PROGRAM_RAM_04,				    0x3C,			&ADAU_PROGRAM_RAM_04[0]					},
	{ADAU_ADDR_PROGRAM_RAM_05,				    0x3C,			&ADAU_PROGRAM_RAM_05[0]					},
	{ADAU_ADDR_PROGRAM_RAM_06,				    0x3C,			&ADAU_PROGRAM_RAM_06[0]					},
	{ADAU_ADDR_PROGRAM_RAM_07,				    0x3C,			&ADAU_PROGRAM_RAM_07[0]					},
	{ADAU_ADDR_PROGRAM_RAM_08,				    0x3C,			&ADAU_PROGRAM_RAM_08[0]					},
	{ADAU_ADDR_PROGRAM_RAM_09,				    0x3C,			&ADAU_PROGRAM_RAM_09[0]					},
	{ADAU_ADDR_PROGRAM_RAM_10,				    0x3C,			&ADAU_PROGRAM_RAM_10[0]					},
	{ADAU_ADDR_PROGRAM_RAM_11,				    0x3C,			&ADAU_PROGRAM_RAM_11[0]					},
	{ADAU_ADDR_PROGRAM_RAM_12,				    0x3C,			&ADAU_PROGRAM_RAM_12[0]					},
	{ADAU_ADDR_PROGRAM_RAM_13,				    0x3C,			&ADAU_PROGRAM_RAM_13[0]					},
	{ADAU_ADDR_PROGRAM_RAM_14,				    0x3C,			&ADAU_PROGRAM_RAM_14[0]					},
	{ADAU_ADDR_PROGRAM_RAM_15,				    0x3C,			&ADAU_PROGRAM_RAM_15[0]					},
	{ADAU_ADDR_PROGRAM_RAM_16,				    0x3C,			&ADAU_PROGRAM_RAM_16[0]					},
	{ADAU_ADDR_PROGRAM_RAM_17,				    0x3C,			&ADAU_PROGRAM_RAM_17[0]					},
	{ADAU_ADDR_PROGRAM_RAM_18,				    0x3C,			&ADAU_PROGRAM_RAM_18[0]					},
	{ADAU_ADDR_PROGRAM_RAM_19,				    0x3C,			&ADAU_PROGRAM_RAM_19[0]					},
	{ADAU_ADDR_PROGRAM_RAM_20,				    0x23,			&ADAU_PROGRAM_RAM_20[0]					},
	{ADAU_ADDR_PROGRAM_RAM_21,				    0x23,			&ADAU_PROGRAM_RAM_21[0]					},
	{ADAU_ADDR_PARAMETER_RAM_0,				    0x3C,			&ADAU_PARAMETER_RAM_0[0]				},
	{ADAU_ADDR_PARAMETER_RAM_1,				    0x3C,			&ADAU_PARAMETER_RAM_1[0]				},
	{ADAU_ADDR_PARAMETER_RAM_2,				    0x3C,			&ADAU_PARAMETER_RAM_2[0]				},
	{ADAU_ADDR_PARAMETER_RAM_3,				    0x3C,			&ADAU_PARAMETER_RAM_3[0]				},
	{ADAU_ADDR_PARAMETER_RAM_4,				    0x3C,			&ADAU_PARAMETER_RAM_4[0]				},
	{ADAU_ADDR_PARAMETER_RAM_5,				    0x3C,			&ADAU_PARAMETER_RAM_5[0]				},
	{ADAU_ADDR_PARAMETER_RAM_6,				    0x3C,			&ADAU_PARAMETER_RAM_6[0]				},
	{ADAU_ADDR_PARAMETER_RAM_7,				    0x3C,			&ADAU_PARAMETER_RAM_7[0]				},
	{ADAU_ADDR_PARAMETER_RAM_8,				    0x04,			&ADAU_PARAMETER_RAM_8[0]				},
	{ADAU_ADDR_DSP_SAMPLING_RATE_2,			    0x01,			&ADAU_DSP_SAMPLING_RATE_2				},
	{ADAU_ADDR_DSP_RUN_1,					    0x01,			&ADAU_DSP_RUN_1							},
	{ADAU_ADDR_DEJITTER_CONTROL_0,			    0x01,			&ADAU_DEJITTER_CONTROL_0				},
	{ADAU_ADDR_DEJITTER_CONTROL_1,			    0x01,			&ADAU_DEJITTER_CONTROL_1				},
};

uint8_t adau_phase[11][4] = {
	{0x00,	0x00,	0x00,	0x00},
	{0x00,	0x06,	0x66,	0x66},
	{0x00,	0x0C,	0xCC,	0xCD},
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	{0x00,	0x40,	0x00,	0x00},
};


/* Private function prototypes -----------------------------------------------*/


/* Private user code ---------------------------------------------------------*/
void adau_hardReset()
{
	// HAL_GPIO_WritePin(DSP_RESET_GPIO_Port, DSP_RESET_Pin, GPIO_PIN_RESET);
	HAL_Delay(10);
	// HAL_GPIO_WritePin(DSP_RESET_GPIO_Port, DSP_RESET_Pin, GPIO_PIN_SET);
	// This delay accounts for ADM811T reset generator hold time on ADAU1467 eval board, adjust
	// as needed
	HAL_Delay(560);
#ifdef ADAU_USE_SPI
	// Toggle the DSP into SPI mode by pulling the /SS pin low, then high, 3 times.
	for (uint8_t i = 0; i < 3; i++)
	{
		HAL_GPIO_WritePin(DSP_SS_GPIO_Port, DSP_SS_Pin, GPIO_PIN_RESET);
		HAL_Delay(10);
		HAL_GPIO_WritePin(DSP_SS_GPIO_Port, DSP_SS_Pin, GPIO_PIN_SET);
		HAL_Delay(10);
	}
#endif
}

void adau_init(void)
{
	// HAL_StatusTypeDef	ack = HAL_BUSY;
	// uint8_t i = 0;
	// Drive Pin 6 of the USBi connector low to reset the DSP and SPI toggle if necessary.
	adau_hardReset();

	// default_download_IC_1, generated by SigmaStudio, will download the SigmaStudio program and start up the
	// DSP. It relies on a proper SPI or I2C implementation in SIGMASTUDIOFW.cpp, which must be tailored to
	// the individual processor. and assigning pins correctly in USER_SETTINGS.h.
	// default_download_IC_1();

	while (ack != HAL_OK)
	{
		ack = HAL_I2C_IsDeviceReady(&hi2c2,DSP_I2C_ADDR,10,50);
		if(ack == HAL_ERROR) i++;
		else if(ack == HAL_BUSY) i++;
		else if(ack == HAL_TIMEOUT) i++;
		if(i > 9)
		{
			ack = HAL_OK;
			soundCt.bDspSoundFlag = I2C_STAT_TIMEOUT;
		}
	}

	// HAL_Delay(1000);

	if(ack == HAL_OK && soundCt.bDspSoundFlag != I2C_STAT_TIMEOUT)
	{
		soundCt.bDspSoundFlag = I2C_STAT_OK;
		for(i = 0; i < 130; i++)
		{
			// HAL_I2C_Mem_Write_2(&hi2c2,ADAU_ADDR_WRITE,adau17x1_reg_defaults[i].addr,I2C_MEMADD_SIZE_16BIT,adau17x1_reg_defaults[i].isi,adau17x1_reg_defaults[i].size,100);
			HAL_I2C_Mem_Write_Const(&hi2c2,ADAU_ADDR_WRITE,adau17x1_reg_defaults[i].addr,I2C_MEMADD_SIZE_16BIT,adau17x1_reg_defaults[i].isi,adau17x1_reg_defaults[i].size,100);
			if(i == 3)
			{
				HAL_Delay(1000);
			}
			else
			{
				HAL_Delay(4);
			}
		}		
	}
}

void adau_shiftPhase(uint8_t phs)
{
	// ADAU_PARAMETER_RAM_0[32] = adau_phase[phs][0];
	// ADAU_PARAMETER_RAM_0[33] = adau_phase[phs][1];
	// ADAU_PARAMETER_RAM_0[34] = adau_phase[phs][2];
	// ADAU_PARAMETER_RAM_0[35] = adau_phase[phs][3];

	adau17x1_i2c_buf[0] = adau_phase[phs][0];
	adau17x1_i2c_buf[1] = adau_phase[phs][1];
	adau17x1_i2c_buf[2] = adau_phase[phs][2];
	adau17x1_i2c_buf[3] = adau_phase[phs][3];

	HAL_I2C_Mem_Write(&hi2c2,ADAU_ADDR_WRITE,0x0008,I2C_MEMADD_SIZE_16BIT,&adau17x1_i2c_buf[0],4,100);
}


#endif 	//USE_SOUND_SHIFT_EN
